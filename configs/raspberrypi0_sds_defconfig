## configs/raspberrypi0_sds_defconfig
```kconfig
BR2_arm=y
BR2_arm1176jzf_s=y
BR2_CCACHE=y
BR2_TOOLCHAIN_BUILDROOT_GLIBC=y
BR2_KERNEL_HEADERS_VERSION=y
BR2_DEFAULT_KERNEL_VERSION="4.9.41"
BR2_PACKAGE_HOST_LINUX_HEADERS_CUSTOM_4_9=y
BR2_TOOLCHAIN_BUILDROOT_CXX=y
BR2_TARGET_GENERIC_HOSTNAME="rpi"
BR2_TARGET_GENERIC_ISSUE=""
BR2_ROOTFS_DEVICE_CREATION_DYNAMIC_EUDEV=y
BR2_TARGET_GENERIC_ROOT_PASSWD="daitogiken"
# BR2_TARGET_GENERIC_GETTY is not set
BR2_SYSTEM_DHCP="eth0"
BR2_TARGET_LOCALTIME="Asia/Tokyo"
BR2_ROOTFS_OVERLAY="board/raspberrypi/overlay"
BR2_ROOTFS_POST_BUILD_SCRIPT="board/raspberrypi0/post-build.sh"
BR2_ROOTFS_POST_IMAGE_SCRIPT="board/raspberrypi0/post-image.sh"
BR2_LINUX_KERNEL=y
BR2_LINUX_KERNEL_CUSTOM_GIT=y
BR2_LINUX_KERNEL_CUSTOM_REPO_URL="https://github.com/raspberrypi/linux.git"
BR2_LINUX_KERNEL_CUSTOM_REPO_VERSION="raspberrypi-kernel_1.20170811-1"
BR2_LINUX_KERNEL_DEFCONFIG="bcmrpi"
BR2_LINUX_KERNEL_DTS_SUPPORT=y
BR2_LINUX_KERNEL_INTREE_DTS_NAME="bcm2708-rpi-b-plus bcm2708-rpi-0-w"
```

## configs/raspberrypi23_sds_defconfig
```kconfig
BR2_arm=y
BR2_cortex_a7=y
BR2_ARM_FPU_NEON_VFPV4=y
BR2_CCACHE=y
BR2_TOOLCHAIN_BUILDROOT_GLIBC=y
BR2_KERNEL_HEADERS_VERSION=y
BR2_DEFAULT_KERNEL_VERSION="4.9.41"
BR2_PACKAGE_HOST_LINUX_HEADERS_CUSTOM_4_9=y
BR2_TOOLCHAIN_BUILDROOT_CXX=y
BR2_TARGET_GENERIC_HOSTNAME="rpi"
BR2_TARGET_GENERIC_ISSUE=""
BR2_ROOTFS_DEVICE_CREATION_DYNAMIC_EUDEV=y
BR2_TARGET_GENERIC_ROOT_PASSWD="daitogiken"
# BR2_TARGET_GENERIC_GETTY is not set
BR2_SYSTEM_DHCP="eth0"
BR2_ROOTFS_OVERLAY="board/raspberrypi/overlay"
BR2_ROOTFS_POST_BUILD_SCRIPT="board/raspberrypi23/post-build.sh"
BR2_ROOTFS_POST_IMAGE_SCRIPT="board/raspberrypi23/post-image.sh"
BR2_LINUX_KERNEL=y
BR2_LINUX_KERNEL_CUSTOM_GIT=y
BR2_LINUX_KERNEL_CUSTOM_REPO_URL="https://github.com/raspberrypi/linux.git"
BR2_LINUX_KERNEL_CUSTOM_REPO_VERSION="raspberrypi-kernel_1.20180817-1"
BR2_LINUX_KERNEL_DEFCONFIG="bcm2709"
BR2_LINUX_KERNEL_DTS_SUPPORT=y
BR2_LINUX_KERNEL_INTREE_DTS_NAME="bcm2710-rpi-3-b-plus bcm2710-rpi-3-b bcm2709-rpi-2-b overlays/i2c-rtc-overlay overlays/adafruit13m-overlay overlays/sds-typec-overlay overlays/gpio-tactsw-overlay"
BR2_LINUX_KERNEL_EXT_FBTFT=y
BR2_PACKAGE_RPI_FIRMWARE=y
BR2_PACKAGE_RX8130CE=y
BR2_TARGET_ROOTFS_EXT2=y
BR2_TARGET_ROOTFS_EXT2_4=y
BR2_TARGET_ROOTFS_EXT2_SIZE="300M"
BR2_PACKAGE_HOST_GENIMAGE=y
```

## configs/raspberrypi4_sds_defconfig
```kconfig
BR2_aarch64=y
BR2_cortex_a72=y
BR2_ARM_FPU_VFPV4=y
BR2_PACKAGE_HOST_LINUX_HEADERS_CUSTOM_6_1=y
BR2_TOOLCHAIN_BUILDROOT_CXX=y
BR2_CCACHE=y
BR2_CCACHE_DIR="$(PWD)/.buildroot-ccache"
BR2_PER_PACKAGE_DIRECTORIES=y
BR2_TARGET_GENERIC_HOSTNAME="rpi"
BR2_TARGET_GENERIC_ISSUE=""
BR2_ROOTFS_DEVICE_CREATION_DYNAMIC_EUDEV=y
BR2_TARGET_GENERIC_ROOT_PASSWD="daitogiken"
BR2_SYSTEM_DHCP="eth0"
BR2_ENABLE_LOCALE_WHITELIST="C en_US ja_JP"
BR2_TARGET_LOCALTIME="Asia/Tokyo"
BR2_ROOTFS_POST_BUILD_SCRIPT="board/raspberrypi4-64/post-build.sh"
BR2_ROOTFS_POST_IMAGE_SCRIPT="board/raspberrypi4-64/post-image.sh"
BR2_LINUX_KERNEL=y
BR2_LINUX_KERNEL_CUSTOM_TARBALL=y
BR2_LINUX_KERNEL_CUSTOM_TARBALL_LOCATION="$(call github,raspberrypi,linux,17f135b742c4edb340afb365873c3a574f7e16cb)/linux-17f135b742c4edb340afb365873c3a574f7e16cb.tar.gz"
BR2_LINUX_KERNEL_DEFCONFIG="bcm2711"
BR2_LINUX_KERNEL_DTS_SUPPORT=y
BR2_LINUX_KERNEL_INTREE_DTS_NAME="broadcom/bcm2711-rpi-4-b"
BR2_LINUX_KERNEL_NEEDS_HOST_OPENSSL=y
BR2_PACKAGE_BUSYBOX_SHOW_OTHERS=y
BR2_PACKAGE_XZ=y
BR2_PACKAGE_BRCMFMAC_SDIO_FIRMWARE_RPI=y
BR2_PACKAGE_BRCMFMAC_SDIO_FIRMWARE_RPI_WIFI=y
BR2_PACKAGE_RPI_FIRMWARE=y
BR2_PACKAGE_RPI_FIRMWARE_VARIANT_PI4=y
BR2_PACKAGE_RPI_FIRMWARE_CONFIG_FILE="board/raspberrypi4-64/config_4_64bit.txt"
BR2_PACKAGE_RNG_TOOLS=y
BR2_PACKAGE_USBUTILS=y
BR2_PACKAGE_RPI_EEPROMUTILS=y
BR2_PACKAGE_PYTHON3=y
BR2_PACKAGE_PYTHON_SERIAL=y
BR2_PACKAGE_RUBY=y
BR2_PACKAGE_LIBVA=y
BR2_PACKAGE_LIBV4L=y
BR2_PACKAGE_LIBV4L_UTILS=y
BR2_PACKAGE_JSON_GLIB=y
BR2_PACKAGE_ZLOG=y
BR2_PACKAGE_LIBOPENH264=y
BR2_PACKAGE_LIBCURL_CURL=y
BR2_PACKAGE_LIBDAEMON=y
BR2_PACKAGE_ICU=y
BR2_PACKAGE_NCURSES_WCHAR=y
BR2_PACKAGE_CLAMAV=y
BR2_PACKAGE_APACHE=y
BR2_PACKAGE_BLUEZ_FIRMWARE=y
BR2_PACKAGE_BLUEZ_TOOLS=y
BR2_PACKAGE_BLUEZ5_UTILS=y
BR2_PACKAGE_BLUEZ5_UTILS_OBEX=y
BR2_PACKAGE_BLUEZ5_UTILS_CLIENT=y
BR2_PACKAGE_BLUEZ5_UTILS_MONITOR=y
BR2_PACKAGE_BLUEZ5_UTILS_DEPRECATED=y
BR2_PACKAGE_BLUEZ5_UTILS_PLUGINS_AUDIO=y
BR2_PACKAGE_BLUEZ5_UTILS_PLUGINS_HEALTH=y
BR2_PACKAGE_BLUEZ5_UTILS_PLUGINS_MESH=y
BR2_PACKAGE_BLUEZ5_UTILS_PLUGINS_MIDI=y
# BR2_PACKAGE_BLUEZ5_UTILS_PLUGINS_NETWORK is not set
BR2_PACKAGE_BLUEZ5_UTILS_PLUGINS_NFC=y
BR2_PACKAGE_BLUEZ5_UTILS_PLUGINS_SAP=y
BR2_PACKAGE_BLUEZ5_UTILS_PLUGINS_SIXAXIS=y
BR2_PACKAGE_BLUEZ5_UTILS_TEST=y
BR2_PACKAGE_BLUEZ5_UTILS_TOOLS_HID2HCI=y
BR2_PACKAGE_BRIDGE_UTILS=y
BR2_PACKAGE_DNSMASQ=y
# BR2_PACKAGE_DNSMASQ_TFTP is not set
BR2_PACKAGE_DROPBEAR=y
BR2_PACKAGE_DROPBEAR_DISABLE_REVERSEDNS=y
BR2_PACKAGE_DROPBEAR_WTMP=y
BR2_PACKAGE_DROPBEAR_LASTLOG=y
BR2_PACKAGE_GESFTPSERVER=y
BR2_PACKAGE_IPERF=y
BR2_PACKAGE_IW=y
BR2_PACKAGE_LFTP=y
BR2_PACKAGE_NTP=y
BR2_PACKAGE_NTP_NTPDATE=y
BR2_PACKAGE_RSYNC=y
BR2_PACKAGE_SOCAT=y
BR2_PACKAGE_UFTP=y
BR2_PACKAGE_WIRELESS_TOOLS=y
BR2_PACKAGE_WPA_SUPPLICANT=y
# BR2_PACKAGE_WPA_SUPPLICANT_NL80211 is not set
BR2_PACKAGE_WPA_SUPPLICANT_EAP=y
BR2_PACKAGE_WPA_SUPPLICANT_CLI=y
BR2_PACKAGE_WPA_SUPPLICANT_WPA_CLIENT_SO=y
BR2_PACKAGE_WPA_SUPPLICANT_PASSPHRASE=y
BR2_PACKAGE_MRSYNC=y
BR2_PACKAGE_FILE=y
BR2_PACKAGE_GNUPG2=y
BR2_PACKAGE_GNUPG2_GPGV=y
BR2_PACKAGE_INOTIFY_TOOLS=y
BR2_PACKAGE_LOGROTATE=y
BR2_PACKAGE_SCREEN=y
BR2_PACKAGE_TMUX=y
BR2_PACKAGE_KMOD_TOOLS=y
BR2_PACKAGE_NANO=y
BR2_TARGET_ROOTFS_EXT2=y
BR2_TARGET_ROOTFS_EXT2_4=y
BR2_TARGET_ROOTFS_EXT2_SIZE="300M"
BR2_PACKAGE_HOST_DOSFSTOOLS=y
BR2_PACKAGE_HOST_GENIMAGE=y
BR2_PACKAGE_HOST_KMOD_XZ=y
BR2_PACKAGE_HOST_MTOOLS=y
```

## configs/raspberrypi_sds_defconfig
```kconfig
BR2_arm=y
BR2_arm1176jzf_s=y
BR2_CCACHE=y
BR2_GLOBAL_PATCH_DIR="board/raspberrypi0/patches"
BR2_TOOLCHAIN_BUILDROOT_GLIBC=y
BR2_KERNEL_HEADERS_VERSION=y
BR2_DEFAULT_KERNEL_VERSION="4.9.41"
BR2_PACKAGE_HOST_LINUX_HEADERS_CUSTOM_4_9=y
BR2_TOOLCHAIN_BUILDROOT_CXX=y
BR2_TARGET_GENERIC_HOSTNAME="rpi"
BR2_TARGET_GENERIC_ISSUE=""
BR2_ROOTFS_DEVICE_CREATION_DYNAMIC_EUDEV=y
BR2_TARGET_GENERIC_ROOT_PASSWD="daitogiken"
BR2_SYSTEM_DHCP="eth0"
BR2_ENABLE_LOCALE_WHITELIST="C en_US ja_JP"
BR2_TARGET_LOCALTIME="Asia/Tokyo"
BR2_ROOTFS_OVERLAY="board/raspberrypi0/overlay"
BR2_ROOTFS_POST_BUILD_SCRIPT="board/raspberrypi0/post-build-sds.sh"
BR2_ROOTFS_POST_IMAGE_SCRIPT="board/raspberrypi0/post-image-sds.sh"
BR2_LINUX_KERNEL=y
BR2_LINUX_KERNEL_CUSTOM_GIT=y
BR2_LINUX_KERNEL_CUSTOM_REPO_URL="https://github.com/raspberrypi/linux.git"
BR2_LINUX_KERNEL_CUSTOM_REPO_VERSION="raspberrypi-kernel_1.20180817-1"
BR2_LINUX_KERNEL_DEFCONFIG="bcmrpi"
BR2_LINUX_KERNEL_DTS_SUPPORT=y
BR2_LINUX_KERNEL_INTREE_DTS_NAME="bcm2708-rpi-b-plus bcm2708-rpi-0-w overlays/i2c-rtc-overlay overlays/adafruit13m-overlay"
BR2_LINUX_KERNEL_EXT_FBTFT=y
BR2_PACKAGE_BUSYBOX_WATCHDOG=y
BR2_PACKAGE_ALSA_UTILS=y
BR2_PACKAGE_ALSA_UTILS_APLAY=y
BR2_PACKAGE_FFMPEG=y
BR2_PACKAGE_FFMPEG_AVRESAMPLE=y
BR2_PACKAGE_FFMPEG_SWSCALE=y
BR2_PACKAGE_GSTREAMER1=y
BR2_PACKAGE_GST1_PLUGINS_BASE_PLUGIN_APP=y
BR2_PACKAGE_GST1_PLUGINS_BASE_PLUGIN_VIDEOCONVERT=y
BR2_PACKAGE_GST1_PLUGINS_BASE_PLUGIN_VIDEOTESTSRC=y
BR2_PACKAGE_GST1_PLUGINS_BASE_PLUGIN_VIDEORATE=y
BR2_PACKAGE_GST1_PLUGINS_BASE_PLUGIN_PANGO=y
BR2_PACKAGE_GST1_PLUGINS_GOOD=y
# BR2_PACKAGE_GST1_PLUGINS_GOOD_PLUGIN_AVI is not set
# BR2_PACKAGE_GST1_PLUGINS_GOOD_PLUGIN_ISOMP4 is not set
BR2_PACKAGE_GST1_PLUGINS_GOOD_PLUGIN_MULTIFILE=y
# BR2_PACKAGE_GST1_PLUGINS_GOOD_PLUGIN_WAVPARSE is not set
BR2_PACKAGE_GST1_PLUGINS_GOOD_PLUGIN_V4L2=y
BR2_PACKAGE_GST1_PLUGINS_BAD=y
BR2_PACKAGE_GST1_PLUGINS_BAD_PLUGIN_MPEGTSMUX=y
BR2_PACKAGE_GST1_PLUGINS_BAD_PLUGIN_VIDEOPARSERS=y
# BR2_PACKAGE_GST1_PLUGINS_BAD_PLUGIN_DIRECTFB is not set
BR2_PACKAGE_GST1_PLUGINS_BAD_PLUGIN_FBDEV=y
BR2_PACKAGE_GST1_PLUGINS_BAD_PLUGIN_HLS=y
BR2_PACKAGE_GST_OMX=y
BR2_PACKAGE_V4L2LOOPBACK=y
BR2_PACKAGE_V4L2LOOPBACK_UTILS=y
BR2_PACKAGE_GDB=y
BR2_PACKAGE_RT_TESTS=y
BR2_PACKAGE_STRACE=y
BR2_PACKAGE_DOSFSTOOLS=y
BR2_PACKAGE_DOSFSTOOLS_FATLABEL=y
BR2_PACKAGE_DOSFSTOOLS_FSCK_FAT=y
BR2_PACKAGE_DOSFSTOOLS_MKFS_FAT=y
BR2_PACKAGE_F2FS_TOOLS=y
BR2_PACKAGE_DIRECTFB=y
BR2_PACKAGE_DIRECTFB_DEBUG=y
BR2_PACKAGE_DIRECTFB_TRACE=y
BR2_PACKAGE_DIRECTFB_DIVINE=y
BR2_PACKAGE_DIRECTFB_SAWMAN=y
BR2_PACKAGE_DIRECTFB_TIFF=y
BR2_PACKAGE_DIRECTFB_IMLIB2=y
BR2_PACKAGE_DIRECTFB_DITHER_RGB16=y
BR2_PACKAGE_DIRECTFB_TESTS=y
BR2_PACKAGE_DIRECTFB_EXAMPLES=y
BR2_PACKAGE_FB_TEST_APP=y
BR2_PACKAGE_FBTERM=y
BR2_PACKAGE_FBV=y
BR2_PACKAGE_SDL2=y
BR2_PACKAGE_SDL2_OPENGLES=y
BR2_PACKAGE_RPI_FIRMWARE=y
BR2_PACKAGE_RPI_FIRMWARE_INSTALL_VCDBG=y
BR2_PACKAGE_RPI_WIFI_FIRMWARE=y
BR2_PACKAGE_DBUS_PYTHON=y
BR2_PACKAGE_RNG_TOOLS=y
BR2_PACKAGE_RX8130CE=y
BR2_PACKAGE_USBUTILS=y
BR2_PACKAGE_RPI_EEPROMUTILS=y
BR2_PACKAGE_PYTHON=y
BR2_PACKAGE_PYTHON_READLINE=y
BR2_PACKAGE_PYTHON_HASHLIB=y
BR2_PACKAGE_PYTHON_DS4DRV=y
BR2_PACKAGE_PYTHON_EVDEV=y
BR2_PACKAGE_PYTHON_GOBJECT=y
BR2_PACKAGE_PYTHON_HIDRAW=y
BR2_PACKAGE_PYTHON_IOCTL_OPT=y
BR2_PACKAGE_PYTHON_JSOCKET=y
BR2_PACKAGE_PYTHON_JSON_RPC=y
BR2_PACKAGE_PYTHON_PSUTIL=y
BR2_PACKAGE_PYTHON_PYGAME=y
BR2_PACKAGE_PYTHON_PYPARTED=y
BR2_PACKAGE_PYTHON_PYUDEV=y
BR2_PACKAGE_PYTHON_REQUESTS=y
BR2_PACKAGE_PYTHON_RPI_GPIO=y
BR2_PACKAGE_PYTHON_SERIAL=y
BR2_PACKAGE_PYTHON_SMBUS_CFFI=y
BR2_PACKAGE_PYTHON_WEBDAVCLIENT=y
BR2_PACKAGE_PYTHON_WERKZEUG=y
BR2_PACKAGE_PYTHON_WIRINGPI=y
BR2_PACKAGE_RUBY=y
BR2_PACKAGE_LIBVA=y
BR2_PACKAGE_LIBV4L=y
BR2_PACKAGE_LIBV4L_UTILS=y
BR2_PACKAGE_WIRINGPI=y
BR2_PACKAGE_JSON_GLIB=y
BR2_PACKAGE_ZLOG=y
BR2_PACKAGE_LIBOPENH264=y
BR2_PACKAGE_LIBCURL=y
BR2_PACKAGE_CURL=y
BR2_PACKAGE_LIBDAEMON=y
BR2_PACKAGE_ICU=y
BR2_PACKAGE_NCURSES_WCHAR=y
BR2_PACKAGE_CLAMAV=y
BR2_PACKAGE_APACHE=y
BR2_PACKAGE_BLUEZ_FIRMWARE=y
BR2_PACKAGE_BLUEZ5_UTILS=y
BR2_PACKAGE_BLUEZ5_UTILS_OBEX=y
BR2_PACKAGE_BLUEZ5_UTILS_CLIENT=y
BR2_PACKAGE_BLUEZ5_UTILS_EXPERIMENTAL=y
BR2_PACKAGE_BLUEZ5_UTILS_TEST=y
BR2_PACKAGE_BRIDGE_UTILS=y
BR2_PACKAGE_DNSMASQ=y
# BR2_PACKAGE_DNSMASQ_TFTP is not set
BR2_PACKAGE_DROPBEAR=y
BR2_PACKAGE_DROPBEAR_DISABLE_REVERSEDNS=y
BR2_PACKAGE_IPERF=y
BR2_PACKAGE_IW=y
BR2_PACKAGE_LFTP=y
BR2_PACKAGE_NTP=y
BR2_PACKAGE_NTP_NTPDATE=y
BR2_PACKAGE_RSYNC=y
BR2_PACKAGE_SOCAT=y
BR2_PACKAGE_WIRELESS_TOOLS=y
BR2_PACKAGE_WPA_SUPPLICANT=y
# BR2_PACKAGE_WPA_SUPPLICANT_NL80211 is not set
BR2_PACKAGE_WPA_SUPPLICANT_EAP=y
BR2_PACKAGE_WPA_SUPPLICANT_CLI=y
BR2_PACKAGE_WPA_SUPPLICANT_WPA_CLIENT_SO=y
BR2_PACKAGE_WPA_SUPPLICANT_PASSPHRASE=y
BR2_PACKAGE_MRSYNC=y
BR2_PACKAGE_UFTP=y
BR2_PACKAGE_FILE=y
BR2_PACKAGE_GNUPG2=y
BR2_PACKAGE_GNUPG2_GPGV2=y
BR2_PACKAGE_INOTIFY_TOOLS=y
BR2_PACKAGE_LOGROTATE=y
BR2_PACKAGE_SCREEN=y
BR2_PACKAGE_TMUX=y
BR2_PACKAGE_IOTOP=y
BR2_PACKAGE_UTIL_LINUX_RAW=y
BR2_PACKAGE_NANO=y
BR2_TARGET_ROOTFS_EXT2=y
BR2_TARGET_ROOTFS_EXT2_4=y
BR2_TARGET_ROOTFS_EXT2_SIZE="300M"
BR2_PACKAGE_HOST_DOSFSTOOLS=y
BR2_PACKAGE_HOST_GENIMAGE=y
BR2_PACKAGE_HOST_MTOOLS=y
BR2_PACKAGE_BLUEZ5_UTILS_GATTTOOL=y
```

## configs/raspberrypi_sds_min_defconfig
```kconfig
BR2_arm=y
BR2_arm1176jzf_s=y
BR2_CCACHE=y
BR2_GLOBAL_PATCH_DIR="board/raspberrypi0/patches"
BR2_TOOLCHAIN_BUILDROOT_GLIBC=y
BR2_KERNEL_HEADERS_VERSION=y
BR2_DEFAULT_KERNEL_VERSION="4.9.41"
BR2_PACKAGE_HOST_LINUX_HEADERS_CUSTOM_4_9=y
BR2_TOOLCHAIN_BUILDROOT_CXX=y
BR2_TARGET_GENERIC_HOSTNAME="rpi"
BR2_TARGET_GENERIC_ISSUE=""
BR2_ROOTFS_DEVICE_CREATION_DYNAMIC_EUDEV=y
BR2_TARGET_GENERIC_ROOT_PASSWD="daitogiken"
# BR2_TARGET_GENERIC_GETTY is not set
BR2_SYSTEM_DHCP="eth0"
BR2_ROOTFS_OVERLAY="board/raspberrypi0/overlay.min"
BR2_ROOTFS_POST_BUILD_SCRIPT="board/raspberrypi0/post-build.sh"
BR2_PACKAGE_RPI_EEPROMUTILS=y
BR2_PACKAGE_PYTHON=y
BR2_PACKAGE_PYTHON_ZLIB=y
BR2_PACKAGE_PYTHON_SMBUS_CFFI=y
BR2_PACKAGE_PYTHON_WIRINGPI=y
# BR2_PACKAGE_IFUPDOWN_SCRIPTS is not set
BR2_TARGET_ROOTFS_CPIO=y
BR2_TARGET_ROOTFS_CPIO_GZIP=y
# BR2_TARGET_ROOTFS_TAR is not set
```

## package/bluez-firmware/Config.in
```kconfig
config BR2_PACKAGE_BLUEZ_FIRMWARE
	bool "bluez-firmware"
	depends on BR2_arm || BR2_aarch64
	help
	  Raspberry Pi 3 and Zero W and Pi 3+ Broadcom Bluetooth module
	  firmware.

	  https://github.com/RPi-Distro/bluez-firmware
```

## package/dotnet-runtime/Config.in
```kconfig
comment "dotnet-runtime needs a toolchain w/ glibc or musl and threads"
	depends on !BR2_TOOLCHAIN_USES_GLIBC && !BR2_TOOLCHAIN_USES_MUSL

config BR2_PACKAGE_DOTNET_RUNTIME
	bool "dotnet-runtime"
	depends on BR2_TOOLCHAIN_USES_GLIBC || BR2_TOOLCHAIN_USES_MUSL
	depends on BR2_TOOLCHAIN_HAS_THREADS
	depends on BR2_PACKAGE_LIBZLIB
	depends on BR2_PACKAGE_OPENSSL
	depends on BR2_PACKAGE_LIBCURL
	depends on BR2_PACKAGE_ICU
	help
	  .NET Core 3.1 Runtime (v3.1.7) - Linux ARM32 binaries

	  https://dotnet.microsoft.com/download/dotnet-core/3.1
```

## package/mrsync/Config.in
```kconfig
config BR2_PACKAGE_MRSYNC
	bool "mrsync"
	depends on BR2_PACKAGE_RSYNC
	help
	  mrsync is a package that consists of utilities for transfering a bunch of files from a master machine to multiple target machines simultaneously by using the multicasting capability in the UNIX system.
```

## package/python-ds4drv/Config.in
```kconfig
config BR2_PACKAGE_PYTHON_DS4DRV
	bool "python-ds4drv"
	depends on BR2_PACKAGE_PYTHON
	select BR2_PACKAGE_PYHON_SETUPTOOLS
```

## package/python-hidraw/Config.in
```kconfig
config BR2_PACKAGE_PYTHON_HIDRAW
	bool "python-hidraw"
	depends on BR2_PACKAGE_PYTHON
	select BR2_PACKAGE_HIDRAW
```

## package/python-ioctl-opt/Config.in
```kconfig
config BR2_PACKAGE_PYTHON_IOCTL_OPT
	bool "python-ioctl-opt"
	depends on BR2_PACKAGE_PYTHON
	select BR2_PACKAGE_IOCTL_OPT
```

## package/python-jsocket/Config.in
```kconfig
config BR2_PACKAGE_PYTHON_JSOCKET
	bool "python-jsocket"
	help
	  Python JSON Server & Client.

	  http://cpiekarski.com/2011/05/09/super-easy-python-json-client-server/
```

## package/python-json-rpc/Config.in
```kconfig
config BR2_PACKAGE_PYTHON_JSON_RPC
	bool "python-json-rpc"
	help
	  JSON-RPC transport implementation.

	  https://github.com/pavlov99/json-rpc
```

## package/python-pybluez/Config.in
```kconfig
config BR2_PACKAGE_PYTHON_PYBLUEZ
	bool "python-pybluez"
	depends on BR2_PACKAGE_PYTHON
	select BR2_PACKAGE_PYBLUEZ
```

## package/python-webdavclient/Config.in
```kconfig
config BR2_PACKAGE_PYTHON_WEBDAVCLIENT
	bool "python-webdavclient"
	select BR2_PACKAGE_PYTHON_PYCURL # runtime
	select BR2_PACKAGE_PYTHON_LXML # runtime
	select BR2_PACKAGE_PYTHON_ARGCOMPLETE # runtime
	help
	  Webdav API, resource API и wdc для WebDAV-серверов (Yandex.Disk,
	  Dropbox, Google Disk, Box, 4shared и т.д.).

	  https://github.com/designerror/webdavclient
```

## package/rpi-eepromutils/Config.in
```kconfig
config BR2_PACKAGE_RPI_EEPROMUTILS
	bool "rpi-eepromutils"
	help
	  Utilities to create, flash and dump HAT EEPROM images.

	  https://github.com/raspberrypi/hats/tree/master/eepromutils
```

## package/rpi-utils/Config.in
```kconfig
config BR2_PACKAGE_RPI_UTILS
    bool "rpi-utils"
    depends on BR2_PACKAGE_DTC
    help
      Enable rpi-utils support
```

## package/rx8130ce/Config.in
```kconfig
config BR2_PACKAGE_RX8130CE
	bool "rx8130ce"
	depends on BR2_LINUX_KERNEL
	help
	  A standalone driver for the RX8130CE.

comment "rx8130ce needs a Linux kernel to be built"
	depends on !BR2_LINUX_KERNEL
```

## package/timer-tools/Config.in
```kconfig
config BR2_PACKAGE_TIMER_TOOLS
	bool "timer tools"

config BR2_PACKAGE_ARCH_TIMER_CONTROL
	bool "arch timer control"
	depends on BR2_PACKAGE_TIMER_TOOLS
```

## package/usbtop/Config.in
```kconfig
config BR2_PACKAGE_USBTOP
	bool "usbtop"
	select BR2_PACKAGE_LIBPCAP
	help
	  usbtop
	  usbtop is a top-like utility that shows an estimated instantaneous bandwidth on USB buses and devices.

	  https://github.com/aguinet/usbtop
```
